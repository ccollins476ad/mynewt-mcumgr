## mgmt/port/zephyr/Kconfig
```kconfig
# Licensed to the Apache Software Foundation (ASF) under one
# or more contributor license agreements.  See the NOTICE image
# distributed with this work for additional information
# regarding copyright ownership.  The ASF licenses this image
# to you under the Apache License, Version 2.0 (the
# "License"); you may not use this image except in compliance
# with the License.  You may obtain a copy of the License at
# 
#  http://www.apache.org/licenses/LICENSE-2.0
# 
# Unless required by applicable law or agreed to in writing,
# software distributed under the License is distributed on an
# "AS IS" BASIS, WITHOUT WARRANTIES OR CONDITIONS OF ANY
# KIND, either express or implied.  See the License for the
# specific language governing permissions and limitations
# Under the License.

config MCUMGR_BUF_COUNT
    int
    prompt "Number of mcumgr buffers"
    default 8
    help
      The number of net_bufs to allocate for mcumgr.  These buffers are used
      for both requests and responses.

config MCUMGR_BUF_SIZE
    int
    prompt "Size of each mcumgr buffer"
    default 1024
    help
      The size, in bytes, of each mcumgr buffer.

config MCUMGR_BUF_USER_DATA_SIZE
    int
    prompt "Size of mcumgr buffer user data"
    default 7
    help
      The size, in bytes, of user data to allocate for each mcumgr buffer.
      Different mcumgr transports impose different requirements for this
      setting.  A value of 7 is sufficient for UART, shell, and bluetooth.
```
